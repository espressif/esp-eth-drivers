## ch390/examples/iperf/main/Kconfig.projbuild
```kconfig
menu "Example Configuration"

    orsource "$IDF_PATH/examples/common_components/env_caps/$IDF_TARGET/Kconfig.env_caps"
    
    config IPERF_ETH_SPI_HOST
        int "SPI Host Number"
        range 0 2
        default 1
        help
            Set the SPI host used to communicate with the SPI Ethernet Controller.
    
    config IPERF_ETH_SPI_SCLK_GPIO
        int "SPI SCLK GPIO number"
        range ENV_GPIO_RANGE_MIN ENV_GPIO_OUT_RANGE_MAX
        default 14 if IDF_TARGET_ESP32
        default 12 if IDF_TARGET_ESP32S2 || IDF_TARGET_ESP32S3
        default 6 if IDF_TARGET_ESP32C3 || IDF_TARGET_ESP32C2 || IDF_TARGET_ESP32C6
        default 4 if IDF_TARGET_ESP32H2
        help
            Set the GPIO number used by SPI SCLK.

    config IPERF_ETH_SPI_MOSI_GPIO
        int "SPI MOSI GPIO number"
        range ENV_GPIO_RANGE_MIN ENV_GPIO_OUT_RANGE_MAX
        default 13 if IDF_TARGET_ESP32
        default 11 if IDF_TARGET_ESP32S2 || IDF_TARGET_ESP32S3
        default 7 if IDF_TARGET_ESP32C3 || IDF_TARGET_ESP32C2 || IDF_TARGET_ESP32C6
        default 5 if IDF_TARGET_ESP32H2
        help
            Set the GPIO number used by SPI MOSI.

    config IPERF_ETH_SPI_MISO_GPIO
        int "SPI MISO GPIO number"
        range ENV_GPIO_RANGE_MIN ENV_GPIO_IN_RANGE_MAX
        default 12 if IDF_TARGET_ESP32
        default 13 if IDF_TARGET_ESP32S2 || IDF_TARGET_ESP32S3
        default 2 if IDF_TARGET_ESP32C3 || IDF_TARGET_ESP32C2 || IDF_TARGET_ESP32C6
        default 0 if IDF_TARGET_ESP32H2
        help
            Set the GPIO number used by SPI MISO.

    config IPERF_ETH_SPI_CLOCK_MHZ
        int "SPI clock speed (MHz)"
        range 1 50
        default 40
        help
            Set the clock speed (MHz) of SPI interface.        

    config IPERF_ETH_SPI_CS_GPIO
        int "SPI CS GPIO number for SPI Ethernet module"
        range ENV_GPIO_RANGE_MIN ENV_GPIO_OUT_RANGE_MAX
        default 15 if IDF_TARGET_ESP32
        default 10 if IDF_TARGET_ESP32S2 || IDF_TARGET_ESP32C3 || IDF_TARGET_ESP32S3 || IDF_TARGET_ESP32C2
        default 3 if IDF_TARGET_ESP32C6
        default 1 if IDF_TARGET_ESP32H2
        help
            Set the GPIO number used by SPI CS).

    config IPERF_ETH_SPI_INT_GPIO
        int "Interrupt GPIO number SPI Ethernet module"
        range -1 ENV_GPIO_IN_RANGE_MAX
        default 4 if IDF_TARGET_ESP32 || IDF_TARGET_ESP32S2 || IDF_TARGET_ESP32C3 || IDF_TARGET_ESP32S3
        default 4 if IDF_TARGET_ESP32C2 || IDF_TARGET_ESP32C6
        default 10 if IDF_TARGET_ESP32H2
        help
            Set the GPIO number used by SPI Ethernet module interrupt line.
            Set -1 to use SPI Ethernet module in polling mode.

    config IPERF_ETH_SPI_POLLING_MS_VAL
        depends on EXAMPLE_ETH_SPI_INT_GPIO < 0
        int "Polling period in msec of SPI Ethernet Module"
        default 10
        help
            Set SPI Ethernet module polling period.

    config IPERF_ETH_SPI_PHY_RST_GPIO
        int "PHY Reset GPIO number of SPI Ethernet Module"
        range -1 ENV_GPIO_OUT_RANGE_MAX
        default -1
        help
            Set the GPIO number used to reset PHY chip on the SPI Ethernet module.
            Set to -1 to disable PHY chip hardware reset.

endmenu
```

## ch395/Kconfig
```kconfig
menu "CH395 Configuration"

    orsource "$IDF_PATH/examples/common_components/env_caps/$IDF_TARGET/Kconfig.env_caps"
    
    if ETH_ENABLED
        choice ETH_CH395_INTERFACE
            prompt "CH395 Communication Interface"
            default ETH_CH395_INTERFACE_UART

            config ETH_CH395_INTERFACE_UART
                bool "Use UART to communicate"
            
            config ETH_CH395_INTERFACE_SPI
                depends on ETH_USE_SPI_ETHERNET
                bool "Use SPI to communicate"
        endchoice
    endif
endmenu
```

## ch395/examples/iperf/main/Kconfig.projbuild
```kconfig
menu "Example Configuration"

    orsource "$IDF_PATH/examples/common_components/env_caps/$IDF_TARGET/Kconfig.env_caps"

    config IPERF_ETH_SPI_HOST
        depends on ETH_CH395_INTERFACE_SPI
        int "SPI Host Number"
        range 0 2
        default 1
        help
            Set the SPI host used to communicate with the SPI Ethernet Controller.
    
    config IPERF_ETH_SPI_SCLK_GPIO
        depends on ETH_CH395_INTERFACE_SPI
        int "SPI SCLK GPIO number"
        range ENV_GPIO_RANGE_MIN ENV_GPIO_OUT_RANGE_MAX
        default 14 if IDF_TARGET_ESP32
        default 12 if IDF_TARGET_ESP32S2 || IDF_TARGET_ESP32S3
        default 6 if IDF_TARGET_ESP32C3 || IDF_TARGET_ESP32C2 || IDF_TARGET_ESP32C6
        default 4 if IDF_TARGET_ESP32H2
        help
            Set the GPIO number used by SPI SCLK.

    config IPERF_ETH_SPI_MOSI_GPIO
        depends on ETH_CH395_INTERFACE_SPI
        int "SPI MOSI GPIO number"
        range ENV_GPIO_RANGE_MIN ENV_GPIO_OUT_RANGE_MAX
        default 13 if IDF_TARGET_ESP32
        default 11 if IDF_TARGET_ESP32S2 || IDF_TARGET_ESP32S3
        default 7 if IDF_TARGET_ESP32C3 || IDF_TARGET_ESP32C2 || IDF_TARGET_ESP32C6
        default 5 if IDF_TARGET_ESP32H2
        help
            Set the GPIO number used by SPI MOSI.

    config IPERF_ETH_SPI_MISO_GPIO
        depends on ETH_CH395_INTERFACE_SPI
        int "SPI MISO GPIO number"
        range ENV_GPIO_RANGE_MIN ENV_GPIO_IN_RANGE_MAX
        default 12 if IDF_TARGET_ESP32
        default 13 if IDF_TARGET_ESP32S2 || IDF_TARGET_ESP32S3
        default 2 if IDF_TARGET_ESP32C3 || IDF_TARGET_ESP32C2 || IDF_TARGET_ESP32C6
        default 0 if IDF_TARGET_ESP32H2
        help
            Set the GPIO number used by SPI MISO.

    config IPERF_ETH_SPI_CLOCK_MHZ
        depends on ETH_CH395_INTERFACE_SPI
        int "SPI clock speed (MHz)"
        range 1 40
        default 20
        help
            Set the clock speed (MHz) of SPI interface.        

    config IPERF_ETH_SPI_CS_GPIO
        depends on ETH_CH395_INTERFACE_SPI
        int "SPI CS GPIO number for SPI Ethernet module"
        range ENV_GPIO_RANGE_MIN ENV_GPIO_OUT_RANGE_MAX
        default 15 if IDF_TARGET_ESP32
        default 10 if IDF_TARGET_ESP32S2 || IDF_TARGET_ESP32C3 || IDF_TARGET_ESP32S3 || IDF_TARGET_ESP32C2
        default 3 if IDF_TARGET_ESP32C6
        default 1 if IDF_TARGET_ESP32H2
        help
            Set the GPIO number used by SPI CS.
        
    config IPERF_ETH_UART_PORT
        depends on ETH_CH395_INTERFACE_UART
        int "UART Port number"
        range 1 1 if IDF_TARGET_ESP32S2 || IDF_TARGET_ESP32C3 || IDF_TARGET_ESP32C2 || IDF_TARGET_ESP32H2
        range 1 2 if IDF_TARGET_ESP32 || IDF_TARGET_ESP32C6 || IDF_TARGET_ESP32S3
        default 1
        help
            Set the UART port used to communicate with the Ethernet Controller.

    config IPERF_ETH_UART_BAUDRATE
        depends on ETH_CH395_INTERFACE_UART
        int "UART baudrate(bps)"
        range 9600 3000000
        default 3000000
        help
            Set the baudrate of UART port.

    config IPERF_ETH_UART_TX_GPIO
        depends on ETH_CH395_INTERFACE_UART
        int "UART TX GPIO number"
        range ENV_GPIO_RANGE_MIN ENV_GPIO_OUT_RANGE_MAX
        default 2
        help
            Set the GPIO number used by UART TX.
    
    config IPERF_ETH_UART_RX_GPIO
        depends on ETH_CH395_INTERFACE_UART
        int "UART RX GPIO number"
        range ENV_GPIO_RANGE_MIN ENV_GPIO_OUT_RANGE_MAX
        default 1
        help
            Set the GPIO number used by UART RX.

    config IPERF_ETH_INT_GPIO
        depends on ETH_CH395_INTERFACE_UART || ETH_CH395_INTERFACE_SPI
        int "Interrupt GPIO number Ethernet module"
        range -1 ENV_GPIO_IN_RANGE_MAX
        default 4 if IDF_TARGET_ESP32 || IDF_TARGET_ESP32S2 || IDF_TARGET_ESP32C3 || IDF_TARGET_ESP32S3
        default 4 if IDF_TARGET_ESP32C2 || IDF_TARGET_ESP32C6
        default 10 if IDF_TARGET_ESP32H2
        help
            Set the GPIO number used by SPI Ethernet module interrupt line.
            Set -1 to use SPI Ethernet module in polling mode.

    config IPERF_ETH_POLLING_MS_VAL
        depends on IPERF_ETH_INT_GPIO < 0
        depends on ETH_CH395_INTERFACE_UART || ETH_CH395_INTERFACE_SPI
        int "Polling period in msec of Ethernet Module"
        default 10
        help
            Set SPI Ethernet module polling period.

    config IPERF_ETH_PHY_RST_GPIO
        depends on ETH_CH395_INTERFACE_UART || ETH_CH395_INTERFACE_SPI
        int "PHY Reset GPIO number of Ethernet Module"
        range -1 ENV_GPIO_OUT_RANGE_MAX
        default -1
        help
            Set the GPIO number used to reset PHY chip on the SPI Ethernet module.
            Set to -1 to disable PHY chip hardware reset.

endmenu
```

## common_examples/iperf/main/Kconfig.projbuild
```kconfig
menu "Example options"
    config EXAMPLE_ACT_AS_DHCP_SERVER
        bool "Act as a DHCP server"
        default n
        help
            Set ESP32 to act as DHCP server instead of as a client.
endmenu
```

## common_examples/iperf/sdkconfig.defaults
```kconfig
# Run FreeRTOS only on the first core
CONFIG_FREERTOS_UNICORE=y

# Disable watch dog
CONFIG_ESP_INT_WDT=n
CONFIG_ESP_TASK_WDT_EN=n

# Enable lwIP IRAM optimization
CONFIG_LWIP_IRAM_OPTIMIZATION=y

# Enable Ethernet IRAM optimization
CONFIG_ETH_IRAM_OPTIMIZATION=y
```

## common_examples/simple-ethernet/sdkconfig.defaults.dm9051
```kconfig
CONFIG_ETHERNET_INTERNAL_SUPPORT=n

CONFIG_ETHERNET_SPI_SUPPORT=y
CONFIG_ETHERNET_SPI_NUMBER=1
CONFIG_ETHERNET_USE_DM9051=y
CONFIG_ETHERNET_USE_KSZ8851SNL=n
CONFIG_ETHERNET_USE_W5500=n
```

## common_examples/tcp_client/main/Kconfig.projbuild
```kconfig
menu "Example options"
    config EXAMPLE_SERVER_IP_ADDRESS
        string "Server IP address"
        default "192.168.1.1"
        help
            TCP server IP.

    config EXAMPLE_SERVER_PORT
        int "Server port"
        default 8080
        range 1 65535
        help
            TCP server port.
endmenu
```

## common_examples/tcp_server/main/Kconfig.projbuild
```kconfig
menu "Example options"
    config EXAMPLE_TCP_SERVER_PORT
        int "TCP server listening port"
        default 8080
        help
            Set TCP server listening port.

    config EXAMPLE_ACT_AS_DHCP_SERVER
        bool "Act as DHCP server"
        default n
        help
            Set device to act as DHCP server instead of as a client.

    config EXAMPLE_DHCP_LEASE_TIME
        int "DHCP lease time"
        depends on EXAMPLE_ACT_AS_DHCP_SERVER
        default 120 if !ETHERNET_PHY_LAN867X
        default 1 if ETHERNET_PHY_LAN867X
        help
            Set DHCP lease time in units of LWIP_DHCPS_LEASE_UNIT (default 60 seconds).
            Example: Setting this to 1 means a 60-second lease time.

            This setting is particularly important for devices like LAN867X because it always reports
            its link as "up". In a scenario where:

            1. Multiple DHCP clients exist in the network
            2. The DHCP server and some (but not all) clients restart
            3. The server might assign IP addresses without knowledge of still-active clients

            A short lease time helps resolve potential IP conflicts quickly, as remaining
            active clients will attempt to renew their leases sooner.

endmenu
```

## eth_dummy_phy/examples/generic_switch/main/Kconfig.projbuild
```kconfig
menu "Example Configuration"

    orsource "$IDF_PATH/examples/common_components/env_caps/$IDF_TARGET/Kconfig.env_caps"

    config  EXAMPLE_PHY_RST_GPIO
        int "PHY Reset GPIO number"
        range -1 ENV_GPIO_OUT_RANGE_MAX
        default 5
        help
            Set the GPIO number used to reset PHY chip.
            Set to -1 to disable PHY chip hardware reset.

    config EXAMPLE_EXTERNAL_CLK_EN
        bool "Enable external RMII clock oscillator"
        default "y"
        help
            Enable external clock oscillator.

    config EXAMPLE_EXTERNAL_CLK_EN_GPIO
        depends on EXAMPLE_EXTERNAL_CLK_EN
        int "External oscillator enable GPIO"
        range ENV_GPIO_RANGE_MIN ENV_GPIO_OUT_RANGE_MAX
        default 2
        help
            Set GPIO number to enable External clock oscillator.

endmenu
```

## eth_dummy_phy/examples/simple/main/Kconfig.projbuild
```kconfig
menu "Example Configuration"

    choice EXAMPLE_RMII_CLK_DEVICE_TYPE
        prompt "RMII CLK"
        default EXAMPLE_RMII_CLK_SOURCE_DEV
        help
            Configure device type. ESP32 device which is RMII CLK source needs to wait 
            with its Ethernet initialization for the "RMII CLK Sink Device" since 
            the RMII CLK input pin (GPIO0) is also used as a boot strap pin. If 
            the "RMII CLK Source Device" didn't wait, the "RMII CLK Sink Device" 
            could boot into incorrect mode.

        config EXAMPLE_RMII_CLK_SOURCE_DEV
            bool "RMII CLK Source Device"
        config EXAMPLE_RMII_CLK_SINK_DEV
            bool "RMII CLK Sink Device"
    endchoice

    config EXAMPLE_CLK_SINK_READY_GPIO
        int "RMII CLK Sink Device is ready GPIO"
        default 4
        help
            GPIO number at which the "RMII CLK Sink Device" is ready and so the "RMII
            CLK Source Device" can continue in its Ethernet initialization.
    
    config EXAMPLE_DHCP_SERVER_EN
        bool "Enable DHCP Server"
        default n
        help
            Enable the DHCP Server on the device. The DHCP server is enabled only at 
            the first interface if multiple interfaces are available.

endmenu
```
