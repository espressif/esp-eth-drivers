## ethernet_init/examples/simple-ethernet/sdkconfig.defaults.ksz8851snl
```kconfig
CONFIG_ETHERNET_INTERNAL_SUPPORT=n

CONFIG_ETHERNET_SPI_SUPPORT=y
CONFIG_ETHERNET_SPI_NUMBER=1
CONFIG_ETHERNET_USE_DM9051=n
CONFIG_ETHERNET_USE_KSZ8851SNL=y
CONFIG_ETHERNET_USE_W5500=n
```

## ksz8863/examples/simple_switch/main/Kconfig.projbuild
```kconfig
menu "Example Configuration"

    config EXAMPLE_GPIO_RANGE_MIN
        int
        default 0

    config EXAMPLE_GPIO_RANGE_MAX
        int
        default 33 if IDF_TARGET_ESP32
        default 54 if IDF_TARGET_ESP32P4

    choice  EXAMPLE_P3_RMII_CLK
        prompt "KSZ8863 P3 RMII Input Clock Selection"
        default EXAMPLE_P3_RMII_CLKI_INTERNAL
        help
            Select the KSZ8863 RMII REFCLK 50 MHz clock mode. See "KSZ8863RLL Hardware Design Checklist" for more
            information.

        config EXAMPLE_P3_RMII_CLKI_INTERNAL
            bool "RMII REFCLK 50 MHz looped-back internally"
            help
                REFCLKO_3 Output is connected to REFCLKI_3 internally.

        config EXAMPLE_P3_RMII_CLKI_EXTERNAL
            bool "RMII REFCLK 50 MHz sourced externally"
            help
                REFCLKI_3 is sourced externally (i.e. by REFCLKO_3 or by external 50 MHz oscillator).
    endchoice # EXAMPLE_P3_RMII_CLK

    config EXAMPLE_P3_RMII_CLKI_INVERT
        bool "Invert P3 RMII REFCKL"
        default "n"
        help
            Invert P3 RMII REFCKL.

    config EXAMPLE_EXTERNAL_CLK_EN
        bool "Enable external RMII clock oscillator"
        default "y"
        help
            Enable external clock oscillator.

    config EXAMPLE_EXTERNAL_CLK_EN_GPIO
        depends on EXAMPLE_EXTERNAL_CLK_EN
        int "External oscillator enable GPIO"
        range EXAMPLE_GPIO_RANGE_MIN EXAMPLE_GPIO_RANGE_MAX
        default 2
        help
            Set GPIO number to enable External clock oscillator.

    choice EXAMPLE_CTRL_INTERFACE
        prompt "KSZ8863 Configuration Interface"
        default EXAMPLE_CTRL_I2C
        help
            Select the KSZ8863 Configuration interface to use in the example.

        config EXAMPLE_CTRL_I2C
            bool "I2C"
            help
                I2C is to be used as KSZ8863 Configuration interface.

        config EXAMPLE_CTRL_SPI
            bool "SPI"
            help
                SPI is to be used as KSZ8863 Configuration interface.
    endchoice # EXAMPLE_CTRL_INTERFACE

    if EXAMPLE_CTRL_I2C
        config EXAMPLE_I2C_MASTER_PORT
            int "I2C Port Number"
            range 0 1
            default 0
            help
                Set the I2C port (controller) responsible for handling communications on the I2C bus.

        config EXAMPLE_I2C_SDA_GPIO
            int "I2C SDA GPIO Number"
            range EXAMPLE_GPIO_RANGE_MIN EXAMPLE_GPIO_RANGE_MAX
            default 18
            help
                Set the GPIO number used by I2C serial data line (SDA).

        config EXAMPLE_I2C_SCL_GPIO
            int "I2C SCL GPIO Number"
            range EXAMPLE_GPIO_RANGE_MIN EXAMPLE_GPIO_RANGE_MAX
            default 23
            help
                Set the GPIO number used by I2C serial clock (SCL).

        config EXAMPLE_I2C_CLOCK_KHZ
            int "I2C clock speed (kHz)"
            range 1 400
            default 400
            help
                Set the clock speed (kHz) of I2C interface.

    endif # EXAMPLE_CTRL_I2C

    if EXAMPLE_CTRL_SPI
        config EXAMPLE_ETH_SPI_HOST
            int "SPI Host Number"
            range 0 2
            default 1
            help
                Set the SPI host used to communicate with the SPI Ethernet Controller.

        config EXAMPLE_ETH_SPI_SCLK_GPIO
            int "SPI SCLK GPIO number"
            range EXAMPLE_GPIO_RANGE_MIN EXAMPLE_GPIO_RANGE_MAX
            default 14
            help
                Set the GPIO number used by SPI SCLK.

        config EXAMPLE_ETH_SPI_MOSI_GPIO
            int "SPI MOSI GPIO number"
            range EXAMPLE_GPIO_RANGE_MIN EXAMPLE_GPIO_RANGE_MAX
            default 13
            help
                Set the GPIO number used by SPI MOSI.

        config EXAMPLE_ETH_SPI_MISO_GPIO
            int "SPI MISO GPIO number"
            range EXAMPLE_GPIO_RANGE_MIN EXAMPLE_GPIO_RANGE_MAX
            default 12
            help
                Set the GPIO number used by SPI MISO.

        config EXAMPLE_ETH_SPI_CLOCK_MHZ
            int "SPI clock speed (MHz)"
            range 5 80
            default 12
            help
                Set the clock speed (MHz) of SPI interface.

        config EXAMPLE_ETH_SPI_CS_GPIO
            int "SPI CS0 GPIO number"
            range EXAMPLE_GPIO_RANGE_MIN EXAMPLE_GPIO_RANGE_MAX
            default 15
            help
                Set the GPIO number used by SPI CS0.

    endif # EXAMPLE_CTRL_SPI

    config EXAMPLE_KSZ8863_RST_GPIO
        int "KSZ8863 Reset GPIO number"
        range -1 EXAMPLE_GPIO_RANGE_MAX
        default 5
        help
            Set the GPIO number used to reset the chip.
            Set to -1 to disable chip hardware reset.
endmenu
```

## ksz8863/examples/switch_mode/sdkconfig.defaults
```kconfig
CONFIG_ETH_USE_ESP32_EMAC=y
CONFIG_ESP_NETIF_L2_TAP=y
CONFIG_ETH_TRANSMIT_MUTEX=y
```

## ksz8863/examples/two_ports_mode/sdkconfig.defaults
```kconfig
CONFIG_ETH_USE_ESP32_EMAC=y
CONFIG_ESP_NETIF_L2_TAP=y
CONFIG_ETH_TRANSMIT_MUTEX=y
# CONFIG_ETH_RMII_CLK_INPUT is not set
CONFIG_ETH_RMII_CLK_OUTPUT=y
```

## ksz8863/test_apps/sdkconfig.defaults
```kconfig
CONFIG_EXAMPLE_GPIO_RANGE_MIN=0
CONFIG_EXAMPLE_GPIO_RANGE_MAX=33
CONFIG_EXAMPLE_P3_RMII_CLKI_INTERNAL=y
CONFIG_EXAMPLE_EXTERNAL_CLK_EN=y
CONFIG_EXAMPLE_EXTERNAL_CLK_EN_GPIO=2
CONFIG_EXAMPLE_CTRL_I2C=y
CONFIG_EXAMPLE_I2C_MASTER_PORT=0
CONFIG_EXAMPLE_I2C_SDA_GPIO=18
CONFIG_EXAMPLE_I2C_SCL_GPIO=23
CONFIG_EXAMPLE_I2C_CLOCK_KHZ=400
CONFIG_EXAMPLE_KSZ8863_RST_GPIO=5
```

## lan867x/examples/lan867x_tcp_sockets/client/main/Kconfig.projbuild
```kconfig
menu "Example Configuration"
    config EXAMPLE_LAN867X_USE_PLCA
        bool "Use PLCA"
        default n
        help
            Use PLCA instead of CSMA/CD, in some cases PLCA may be more robust against collisions

    config EXAMPLE_LAN867X_PLCA_ID
        depends on EXAMPLE_LAN867X_USE_PLCA
        int "LAN867x PLCA id"
        range 1 255
        default 1
        help
            Set PLCA id (each device in the network must have unique PLCA id)
endmenu
```

## lan867x/examples/lan867x_tcp_sockets/server/main/Kconfig.projbuild
```kconfig
menu "Example Configuration"
    config EXAMPLE_LAN867X_USE_PLCA
        bool "Use PLCA"
        default n
        help
            Use PLCA instead of CSMA/CD, in some cases PLCA may be more robust against collisions

    config EXAMPLE_LAN867X_PLCA_NODE_COUNT
        depends on EXAMPLE_LAN867X_USE_PLCA
        int "PLCA node count"
        range 2 255
        default 2
        help
            Set PLCA node count (amount of nodes in the network including this one)
endmenu
```
